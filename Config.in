## Config.in
```kconfig
menu "Audio and video applications"
source "../multimedia/alsa-plugins/Config.in"
source "../multimedia/amaudio/Config.in"
source "../multimedia/audiocapture/Config.in"
source "../multimedia/mediasupport/Config.in"

# Gstreamer 0.10.x & Plugins
source "../multimedia/gst-fluendo-mpegdemux/Config.in"
source "../multimedia/gst-aml-plugins/Config.in"
source "../multimedia/gst-aml-plugins1/Config.in"
source "../multimedia/gst-app/Config.in"

source "../multimedia/libplayer/Config.in"
source "../multimedia/wifidisplay/Config.in"
source "../multimedia/test_tool/spdif_in_dd_decoder/Config.in"
endmenu
```

## secfirmload/Config.in
```kconfig
config BR2_PACKAGE_SECFIRMLOAD
	bool "secfirmload"
	default n
	help
	  secure load  video firmware under optee.
	  
config BR2_PACKAGE_LAUNCHER_USE_SECFIRMLOAD
	bool "preload secure firmware when boot"
	default n
	help
	  preload secure firmware when boot.
	  
```
